char dipsw[4] = {8, 9, 10, 11}; // 輸入的腳位
char led_num[16][8] = {
  {6, 0, 1, 2, 3, 4, 5},    // 0
  {2, 1, 2},                // 1
  {5, 0, 1, 3, 4, 6},       // 2    
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  {4, 0, 4, 5, 6}           // F 15
};   

int num=0;             
int i=0;   

void led_dark() {             // 將 LED 全部熄滅
  for (i = 0; i <= 7; i++) {
    digitalWrite(i, HIGH); 
  }
} 

void setup() {
  for (i = 0; i <= 7; i++) {
    pinMode(i, OUTPUT);           // 設定接腳 0-7 為輸出
  }
  for (i = 8; i <= 11; i++) {
    pinMode(i, INPUT);            // 設定接腳 8-11 為輸入   
  }
  led_dark();
}
   
void loop() {
  int z;
  num = 0;
  
  // 讀取 DIP 開關並將其組成一個整數
  for (i = 0; i <= 3; i++) {
    num |= digitalRead(dipsw[i]) << i;
  }

  // 使用整數 `num` 來查找對應的 LED 段碼
  z = led_num[num][0]; // 知道這一列裡面有多少個元素
  for (i = 1; i <= z; i++) {
    digitalWrite(led_num[num][i], LOW); // 低電壓讓 LED 亮起
  }

  delay(100); // 顯示該數字的時間
  led_dark(); // 全部熄滅以避免重疊
}
